#include "Driver/Chip/Oled.h"
#include "Driver/St/Sys.h"

const uint8_t OledCharSize = 16;
const uint8_t OledMaxColumn = 128;

//常用ASCII表
//偏移量32
//ASCII字符集
//偏移量32
//大小:12*6
/************************************6*8的点阵************************************/
const uint8_t F6x8[][6] =		
{
    0x00, 0x00, 0x00, 0x00, 0x00, 0x00,// sp
    0x00, 0x00, 0x00, 0x2f, 0x00, 0x00,// !
    0x00, 0x00, 0x07, 0x00, 0x07, 0x00,// "
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    0x14, 0x14, 0x14, 0x14, 0x14, 0x14,// horiz lines
};
/****************************************8*16的点阵************************************/
const uint8_t F8X16[]=	  
{
#if 0  
    0x00,0x00,0x00,0x00,0x00,0x00,0x00,0x00,0x00,0x00,0x00,0x00,0x00,0x00,0x00,0x00,// 0
    0x00,0x00,0x00,0xF8,0x00,0x00,0x00,0x00,0x00,0x00,0x00,0x33,0x30,0x00,0x00,0x00,//! 1
    0x00,0x10,0x0C,0x06,0x10,0x0C,0x06,0x00,0x00,0x00,0x00,0x00,0x00,0x00,0x00,0x00,//" 2
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    0x00,0x06,0x01,0x01,0x02,0x02,0x04,0x04,0x00,0x00,0x00,0x00,0x00,0x00,0x00,0x00 //~ 94
#else
    0x00,0x00,0x00,0x00,0x00,0x00,0x00,0x00,0x00,0x00,0x00,0x00,0x00,0x00,0x00,0x00,// 0
    0x00,0x00,0x70,0xF8,0xF8,0x70,0x00,0x00,0x00,0x00,0x00,0x0D,0x0D,0x00,0x00,0x00,/*"!",1*/
    0x00,0x38,0x38,0x00,0x00,0x38,0x38,0x00,0x00,0x00,0x00,0x00,0x00,0x00,0x00,0x00,/*""",2*/
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	0x00,0x00,0xF8,0xF0,0xE0,0xC0,0x80,0x00,0x00,0x00,0x0F,0x07,0x03,0x01,0x00,0x00/*"fg",95*/
#endif
};


const uint8_t Logo_MO_2300D[] = 
{
    0x00, 0x00, 0x00, 0x00, 0x00, 0x00, 0x00, 0x00, 0x00, 0x00, 0x00, 0x00, 0x00, 0x00, 0x00, 0x00, 
    0x00, 0x00, 0x00, 0x00, 0x00, 0x00, 0x00, 0x00, 0x00, 0x00, 0x00, 0x00, 0x00, 0x00, 0x00, 0x00, 
    0x00, 0x00, 0x00, 0x00, 0x00, 0x00, 0x00, 0x00, 0x00, 0x00, 0x00, 0x00, 0x00, 0x00, 0x00, 0x00, 
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    0x00, 0x00, 0x00, 0x00, 0x00, 0x00, 0x00, 0x00, 0x00, 0x00, 0x00, 0x00, 0x00, 0x00, 0x00, 0x00
};

//m^n函数
uint32_t Pow(uint8_t m,uint8_t n)
{
	uint32_t result=1;	 
	while(n--)result*=m;    
	return result;
}

Oled::Oled(OledParam &param) {
  i2c_ = new I2c(param.i2cAddress_, false);
  resetIo_ = new Gpio(param.resetIoParam_);
  resetIo_->Init();
  enableIo_ = new Gpio(param.enableIoParem_);
  enableIo_->Init();
}

void Oled::WriteOneByte(uint8_t op, uint8_t data) {
    i2c_->Send(&data, op, 1);
}

void Oled::DisplayOn() {
    WriteOneByte(oldeOp_Cmd,0xAF);  //DISPLAY ON
}

void Oled::DisplayOff() {
    WriteOneByte(oldeOp_Cmd,0xAE);  //DISPLAY ON
}

void Oled::SetPos(uint8_t x, uint8_t y) {
	WriteOneByte(oldeOp_Cmd, 0xb0+y);
	WriteOneByte(oldeOp_Cmd, ((x&0xf0)>>4)|0x10);
	WriteOneByte(oldeOp_Cmd, (x&0x0f)|0x01); 
}

void Oled::Init() {
    enableIo_->Enable();
    resetIo_->Enable();
    Sys::DelayMs(100);
    
    resetIo_->Disable();
    Sys::DelayMs(100);
  
    resetIo_->Enable();
    
	WriteOneByte(oldeOp_Cmd, 0xAE);//--turn off oled panel
    WriteOneByte(oldeOp_Cmd, 0x00);//---set low column address
    WriteOneByte(oldeOp_Cmd, 0x10);//---set high column address
    WriteOneByte(oldeOp_Cmd, 0x40);//--set start line address  Set Mapping RAM Display Start Line (0x00~0x3F)
    WriteOneByte(oldeOp_Cmd, 0x81);//--set contrast control register
    WriteOneByte(oldeOp_Cmd, 0xCF); // Set SEG Output Current Brightness
    WriteOneByte(oldeOp_Cmd, 0xA1);//--Set SEG/Column Mapping     0xa0左右反置 0xa1正常
    WriteOneByte(oldeOp_Cmd, 0xC8);//Set COM/Row Scan Direction   0xc0上下反置 0xc8正常
    WriteOneByte(oldeOp_Cmd, 0xA6);//--set normal display
    WriteOneByte(oldeOp_Cmd, 0xA8);//--set multiplex ratio(1 to 64)
    WriteOneByte(oldeOp_Cmd, 0x3f);//--1/64 duty
    WriteOneByte(oldeOp_Cmd, 0xD3);//-set display offset	Shift Mapping RAM Counter (0x00~0x3F)
    WriteOneByte(oldeOp_Cmd, 0x00);//-not offset
    WriteOneByte(oldeOp_Cmd, 0xd5);//--set display clock divide ratio/oscillator frequency
    WriteOneByte(oldeOp_Cmd, 0x80);//--set divide ratio, Set Clock as 100 Frames/Sec
    WriteOneByte(oldeOp_Cmd, 0xD9);//--set pre-charge period
    WriteOneByte(oldeOp_Cmd, 0xF1);//Set Pre-Charge as 15 Clocks & Discharge as 1 Clock
    WriteOneByte(oldeOp_Cmd, 0xDA);//--set com pins hardware configuration
    WriteOneByte(oldeOp_Cmd, 0x12);
    WriteOneByte(oldeOp_Cmd, 0xDB);//--set vcomh
    WriteOneByte(oldeOp_Cmd, 0x40);//Set VCOM Deselect Level
    WriteOneByte(oldeOp_Cmd, 0x20);//-Set Page Addressing Mode (0x00/0x01/0x02)
    WriteOneByte(oldeOp_Cmd, 0x02);//
    WriteOneByte(oldeOp_Cmd, 0x8D);//--set Charge Pump enable/disable
    WriteOneByte(oldeOp_Cmd, 0x14);//--set(0x10) disable
    WriteOneByte(oldeOp_Cmd, 0xA4);// Disable Entire Display On (0xa4/0xa5)
    WriteOneByte(oldeOp_Cmd, 0xA6);// Disable Inverse Display On (0xa6/a7) 
    WriteOneByte(oldeOp_Cmd, 0xAF);//--turn on oled panel
    WriteOneByte(oldeOp_Cmd, 0xAF); /*display ON*/   
    
    
    Clear();
    SetPos(0,0);
    //uint8_t chr[] = "192.168.000.001 255.255.000.000 192.168.100.000";
    //ShowString(0, 0, chr);
    DrawBMP(0, 0, 128, 8, Logo_MO_2300D);
}

//清屏函数,清完屏,整个屏幕是黑色的!和没点亮一样!!!	
void Oled::Clear() {
    uint8_t i,n;		    
    for(i=0;i<8;i++)  
    {  
        WriteOneByte(oldeOp_Cmd, 0xb0+i);    //设置页地址（0~7）
        WriteOneByte(oldeOp_Cmd, 0x00);      //设置显示位置—列低地址
        WriteOneByte(oldeOp_Cmd, 0x10);      //设置显示位置—列高地址   
        for(n=0;n<OledMaxColumn;n++)WriteOneByte(oledOp_Data, 0); 
    } //更新显示
}

#if 0
void Oled::DrawPoint(uint8_t x,uint8_t y,uint8_t t) {

}

void Oled::Fill(uint8_t x1, uint8_t y1, uint8_t x2, uint8_t y2, uint8_t dot) {

}
#endif

//在指定位置显示一个字符,包括部分字符
//x:0~127
//y:0~63
//mode:0,反白显示;1,正常显示				 
//size:选择字体 16/12 
void Oled::ShowChar(uint8_t x, uint8_t y, uint8_t chr) {
	uint8_t c=0,i=0;	
	c=chr-' ';//得到偏移后的值			
	if(x>OledMaxColumn-1)
        {x=0;y=y+2;}

    if(OledCharSize == 16)
	{
        SetPos(x,y);	
        for(i=0;i<8;i++)
            WriteOneByte(oledOp_Data, F8X16[c*16+i]);
        SetPos(x,y+1);
        for(i=0;i<8;i++)
            WriteOneByte(oledOp_Data, F8X16[c*16+i+8]);
    }
    else {
   		SetPos(x,y+1);
		for(i=0;i<6;i++)
			WriteOneByte(oledOp_Data, F6x8[c][i]); 
    }
}

//显示2个数字
//x,y :起点坐标	 
//len :数字的位数
//size:字体大小
//mode:模式	0,填充模式;1,叠加模式
//num:数值(0~4294967295);	
void Oled::ShowNum(uint8_t x, uint8_t y,uint32_t num, uint8_t len, uint8_t size2) {
	uint8_t t,temp;
	uint8_t enshow=0;						   
	for(t=0;t<len;t++)
	{
		temp=(num/Pow(10,len-t-1))%10;
		if(enshow==0&&t<(len-1))
		{
			if(temp==0)
			{
				ShowChar(x+(size2/2)*t,y,' ');
				continue;
			}else enshow=1; 
		 	 
		}
	 	ShowChar(x+(size2/2)*t,y,temp+'0'); 
	}
}

//显示一个字符号串
void Oled::ShowString(uint8_t x, uint8_t y, const uint8_t *chr) {
	uint8_t j=0;
	while (chr[j]!='\0')
	{	ShowChar(x,y,chr[j]);
		x+=8;
		if(x>120){x=0;y+=2;}
		j++;
	}
}

#if 0
void Oled::ShowCHinese(uint8_t x, uint8_t y, uint8_t no) {
	uint8_t t,adder=0;
	SetPos(x,y);	
    for(t=0;t<16;t++)
    {
        WriteOneByte(oledOp_Data,Hzk[2*no][t]);
        adder+=1;
    }	
	SetPos(x,y+1);	
    for(t=0;t<16;t++)
    {	
        WriteOneByte(oledOp_Data,Hzk[2*no+1][t]);
        adder+=1;
    }
}
#endif

/***********功能描述：显示显示BMP图片128×64起始点坐标(x,y),x的范围0～127，y为页的范围0～7*****************/
void Oled::DrawBMP(uint8_t x0, uint8_t y0, uint8_t x1, uint8_t y1, const uint8_t BMP[]) {
    uint32_t j=0;
    uint8_t x,y;

    if(y1%8==0) 
        y=y1/8;      
    else 
        y=y1/8+1;
    for(y=y0;y<y1;y++)
    {
        SetPos(x0,y);
        for(x=x0;x<x1;x++)
        {      
            WriteOneByte(oledOp_Data, BMP[j++]);	    	
        }
    }
}
